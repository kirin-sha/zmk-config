## boards/shields/hontonopage/Kconfig.defconfig
```kconfig
if SHIELD_hontonopage

config ZMK_KEYBOARD_NAME
    default "hontonopage"

endif
```

## config/boards/shields/hontonopage/Kconfig.defconfig
```kconfig
if SHIELD_HONTONOPAGE

config ZMK_KEYBOARD_NAME
    default "hontonopage"

endif
```
