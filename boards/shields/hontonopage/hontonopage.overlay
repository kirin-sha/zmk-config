#include "hontonopage.dtsi"

&kscan0 {
        col-gpios
            = <&xiao_d 3 GPIO_ACTIVE_HIGH> //SW_1
            , <&xiao_d 9 GPIO_ACTIVE_HIGH> //SW_2
            , <&xiao_d 8 GPIO_ACTIVE_HIGH> //SW_3
            , <&xiao_d 5 GPIO_ACTIVE_HIGH> //SW_4
            , <&xiao_d 2 GPIO_ACTIVE_HIGH> //SW_5
            , <&xiao_d 6 GPIO_ACTIVE_HIGH> //ENC_A
            , <&xiao_d 7 GPIO_ACTIVE_HIGH> //ENC_B
            ;
};

&left_encoder {
    status = "okay";
};