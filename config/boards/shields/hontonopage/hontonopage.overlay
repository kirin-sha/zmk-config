#include "hontonopage.dtsi"
#include <behaviors.dtsi>
#include <dt-bindings/zmk/behaviors.h>

/ {
    behaviors {
        hold_tap: hold_tap {
            compatible = "zmk,behavior-hold-tap";
            #binding-cells = <2>;
            flavor = "balanced";
            tapping-term-ms = <200>;
            quick-tap-ms = <0>;
            bindings = <&mo>, <&kp>;
        };

        mod_tap: mod_tap {
            compatible = "zmk,behavior-hold-tap";
            #binding-cells = <2>;
            flavor = "hold-preferred";
            tapping-term-ms = <200>;
            display-name = "Mod-Tap";
            bindings = <&kp>, <&kp>;
        };
    };
};
